OUTPUT_FORMAT(binary)
ENTRY(_start)                /* the name of the entry label */

SECTIONS {
    . = 0x0010000;          /* the code should be loaded at the kernel offset (preferably at 1MB but for now I place it at a location between 0x00000 and 0xfffff)*/

    .text ALIGN (0x1000) :   /* align at 4 KB */
    {
        *(.text)             /* all text sections from all files */
    }

    .rodata ALIGN (0x1000) : /* align at 4 KB */
    {
        *(.rodata*)          /* all read-only data sections from all files */
    }

    .data ALIGN (0x1000) :   /* align at 4 KB */
    {
        *(.data)             /* all data sections from all files */
    }

    .bss ALIGN (0x1000) :    /* align at 4 KB */
    {
        *(COMMON)            /* all COMMON sections from all files */
        *(.bss)              /* all bss sections from all files */
    }
}
